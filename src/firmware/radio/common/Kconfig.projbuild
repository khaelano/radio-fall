## src/firmware/radio/common/Kconfig.projbuild
```kconfig
menu "CSI board hardware"

choice CSI_BOARD
    prompt "Development board"
    default CSI_BOARD_GENERIC

config CSI_BOARD_GENERIC
    bool "Generic ESP32-C5/C6 (no antenna GPIO control)"

config CSI_BOARD_XIAO_ESP32C6
    bool "Seeed Studio XIAO ESP32-C6"
    depends on IDF_TARGET_ESP32C6

endchoice

config CSI_XIAO_EXTERNAL_ANTENNA
    bool "Use an attached external antenna on XIAO C6"
    depends on CSI_BOARD_XIAO_ESP32C6
    default n
    help
        Enable the RF switch with GPIO3 low. GPIO14 high selects the external
        antenna; otherwise GPIO14 low selects the built-in ceramic antenna.

endmenu

menu "CSI UART companion reference"
config CSI_UART_REFERENCE
    bool "Use native UART0 for the transmitter reference"
    default n
    depends on !CSI_WIRELESS_TRANSMITTER
    help
        A separate C6 owns wireless host communication. The sensing C5 only
        exchanges CRC-protected frames over UART. Disable the UART console.

config CSI_REFERENCE_UART_TX
    int "Reference UART TX GPIO"
    depends on CSI_UART_REFERENCE
    default 11 if IDF_TARGET_ESP32C5
    default 16

config CSI_REFERENCE_UART_RX
    int "Reference UART RX GPIO"
    depends on CSI_UART_REFERENCE
    default 12 if IDF_TARGET_ESP32C5
    default 17

config CSI_REFERENCE_UART_BAUD
    int "Reference UART baud rate"
    depends on CSI_UART_REFERENCE
    range 115200 2000000
    default 921600

config CSI_ESPNOW_UART_RELAY
    bool "Encrypted C6-to-C6 ESP-NOW reference relay"
    default n
    depends on IDF_TARGET_ESP32C6 && !CSI_WIRELESS_TRANSMITTER
    help
        Enable on the dedicated UART companion and the USB gateway only.
        The C5 sensing firmware must not enable this radio transport.
endmenu

menu "CSI wireless transmitter reference"
config CSI_WIRELESS_TRANSMITTER
    bool "Connectionless BLE bridge between transmitter and gateway"
    default n
    depends on BT_NIMBLE_ENABLED
    help
        Extended non-connectable advertisements carry authenticated commands,
        clock exchanges and a bounded reliable transmitter log stream.
        Requires one-time USB pairing on the identified transmitter and gateway.
endmenu
```

## src/firmware/radio/gateway/main/Kconfig.projbuild
```kconfig
menu "CSI gateway experiments"

config CSI_GATEWAY_ACK_MAX_AGE_MS
    int "Maximum age of receiver activity for immediate host ACK forwarding (ms)"
    range 1 50
    default 50
    help
        Experimental admission limit for immediate host acceptance ACKs. ACKs
        remain cached for a later receiver poll when forwarding is skipped.
        The default preserves the existing slot-length activity window.

endmenu
```

## src/firmware/radio/gateway/sdkconfig.defaults
```kconfig
CONFIG_IDF_TARGET="esp32c6"
CONFIG_BT_ENABLED=n
CONFIG_ESP_WIFI_CSI_ENABLED=n
CONFIG_ESP_WIFI_AMPDU_TX_ENABLED=n
CONFIG_FREERTOS_HZ=1000
CONFIG_ESPTOOLPY_FLASHSIZE_4MB=y
CONFIG_ESP_CONSOLE_SECONDARY_NONE=y
CONFIG_ESP_CONSOLE_SECONDARY_USB_SERIAL_JTAG=n
CONFIG_USJ_ENABLE_USB_SERIAL_JTAG=y
CONFIG_ESP_DEFAULT_CPU_FREQ_MHZ_80=y
CONFIG_PM_ENABLE=y
CONFIG_PM_DFS_INIT_AUTO=y
```

## src/firmware/radio/receiver/main/Kconfig.projbuild
```kconfig
menu "CSI receiver"

choice CSI_BAND
    prompt "Wi-Fi band"
    default CSI_BAND_2G
    help
        The fallback band used until a USB-provisioned profile is present.

config CSI_BAND_2G
    bool "2.4 GHz"

config CSI_BAND_5G
    bool "5 GHz (ESP32-C5 only)"

endchoice

config CSI_CHANNEL
    int "Wi-Fi channel"
    range 1 14
    default 6
    help
        Safe 2.4 GHz fallback channel used before USB provisioning. A
        provisioned profile replaces this value at runtime.

config CSI_SEND_MAC
    string "Transmitter MAC address"
    default "1a:00:00:00:00:00"
    help
        MAC address of the transmitter whose packets should be logged.

config CSI_GATEWAY_EVENT_UPLOAD
    bool "Experimental event-driven gateway upload worker"
    default n
    help
        Submit upload frames without a fixed post-submit wait and wake the
        worker on MAC completion or incoming messages. Keep one send in flight
        and retain the configured slot, send cutoff and channel return reserve.

config CSI_USB_CONTROL
    bool "USB profile provisioning control"
    default y
    help
        Expose discovery and staged radio-profile provisioning over the
        native USB Serial/JTAG interface.

endmenu
```

## src/firmware/radio/receiver/sdkconfig.defaults
```kconfig
CONFIG_ESP_CONSOLE_UART_BAUDRATE=921600
CONFIG_ESP_CONSOLE_UART_CUSTOM=y
CONFIG_ESP_WIFI_CSI_ENABLED=y
CONFIG_ESP_WIFI_DYNAMIC_RX_BUFFER_NUM=32
CONFIG_ESP_WIFI_AMPDU_TX_ENABLED=n
CONFIG_FREERTOS_HZ=1000
CONFIG_ESPTOOLPY_FLASHSIZE_4MB=y
CONFIG_PM_ENABLE=y
CONFIG_PM_DFS_INIT_AUTO=y
CONFIG_ESP_DEFAULT_CPU_FREQ_MHZ_80=y
CONFIG_CSI_USB_CONTROL=y
CONFIG_PARTITION_TABLE_SINGLE_APP_LARGE=y
CONFIG_ESP_CONSOLE_SECONDARY_USB_SERIAL_JTAG=n
CONFIG_ESP_CONSOLE_SECONDARY_NONE=y
CONFIG_USJ_ENABLE_USB_SERIAL_JTAG=y
CONFIG_BT_ENABLED=n
```

## src/firmware/radio/receiver/sdkconfig.defaults.ble
```kconfig
CONFIG_CSI_OUTPUT_BLE=y
CONFIG_BT_ENABLED=y
CONFIG_BT_NIMBLE_ENABLED=y
CONFIG_BT_NIMBLE_ROLE_CENTRAL=n
CONFIG_BT_NIMBLE_ROLE_PERIPHERAL=y
CONFIG_BT_NIMBLE_MAX_CONNECTIONS=1
CONFIG_BT_NIMBLE_ATT_PREFERRED_MTU=247
CONFIG_BT_NIMBLE_MSYS_1_BLOCK_COUNT=24
CONFIG_ESP_COEX_SW_COEXIST_ENABLE=y
CONFIG_PARTITION_TABLE_SINGLE_APP_LARGE=y
CONFIG_BT_NIMBLE_HOST_TASK_STACK_SIZE=6144
CONFIG_ESP_CONSOLE_SECONDARY_USB_SERIAL_JTAG=n
CONFIG_ESP_CONSOLE_SECONDARY_NONE=y
CONFIG_USJ_ENABLE_USB_SERIAL_JTAG=y
```

## src/firmware/radio/receiver/sdkconfig.defaults.esp32c6
```kconfig
CONFIG_IDF_TARGET="esp32c6"
CONFIG_ESP_CONSOLE_SECONDARY_USB_SERIAL_JTAG=y
CONFIG_ESP_WIFI_CSI_ENABLED=y
CONFIG_CSI_OUTPUT_SERIAL=y
CONFIG_CSI_USB_CONTROL=y
```

## src/firmware/radio/relay/sdkconfig.defaults
```kconfig
CONFIG_IDF_TARGET="esp32c6"
CONFIG_CSI_UART_REFERENCE=y
CONFIG_CSI_ESPNOW_UART_RELAY=y
CONFIG_ESP_CONSOLE_NONE=y
CONFIG_ESP_CONSOLE_SECONDARY_NONE=y
CONFIG_USJ_ENABLE_USB_SERIAL_JTAG=y
CONFIG_BT_ENABLED=n
CONFIG_ESPTOOLPY_FLASHSIZE_4MB=y
CONFIG_FREERTOS_HZ=1000
CONFIG_ESP_DEFAULT_CPU_FREQ_MHZ_160=y
CONFIG_PM_ENABLE=n
```

## src/firmware/radio/transmitter/main/Kconfig.projbuild
```kconfig
menu "CSI transmitter"

choice CSI_BAND
    prompt "Wi-Fi band"
    default CSI_BAND_2G
    help
        The fallback band used until a USB-provisioned profile is present.

config CSI_BAND_2G
    bool "2.4 GHz"

config CSI_BAND_5G
    bool "5 GHz (ESP32-C5 only)"

endchoice

config CSI_CHANNEL
    int "Wi-Fi channel"
    range 1 14
    default 6
    help
        Safe 2.4 GHz fallback channel used before USB provisioning. A
        provisioned profile replaces this value at runtime.

config CSI_BLE_SCHEDULER
    bool
    depends on (IDF_TARGET_ESP32C5 || IDF_TARGET_ESP32C6) && CSI_USB_CONTROL
    default y

config CSI_TX_POWER_QUARTER_DBM
    int "Maximum sensing transmit power (quarter dBm)"
    range 8 80
    default 44
    help
        Initial limit is 44 (11 dBm). The driver quantizes supported levels.
        Lower power can reduce link margin; verify CSI delivery at the actual
        receiver positions. This is not a measured board-temperature limit.

config CSI_DIAGNOSTIC_HT20
    bool "Diagnostic HT20 sensing (not HE20 collection)"
    default n
    help
        Isolate Wi-Fi PHY problems using HT20 instead of the collection HE20
        PHY. Status explicitly reports ht20 and normal BLE collection rejects
        this diagnostic image. This does not change the provisioned profile.

config CSI_PEER_RETRY_BACKOFF_MS
    int "Retry spacing for unreachable sensing peers (milliseconds)"
    range 0 1000
    default 100
    help
        After a failed MAC acknowledgement, probe that peer again after this
        interval. Successful peers keep the sensing rate. Grant ownership and
        registered slot order never change. This bounds airtime spent on
        disconnected peers; actual submissions remain explicit in round logs.

config CSI_CONTROL_TIMEOUT_MS
    int "Host control lease timeout (milliseconds)"
    range 1000 10000
    default 3000
    help
        Stop sensing and turn off the transmitter Wi-Fi radio if valid host
        clock/control requests stop arriving. Normal host clock polling is 1 Hz.

config CSI_SEND_MAC
    string "Transmitter MAC address"
    default "1a:00:00:00:00:00"
    help
        Locally administered MAC used by the sensing transmitter. Enter six
        hexadecimal octets separated by colons.

config CSI_USB_CONTROL
    bool "USB profile provisioning control"
    default y
    help
        Expose discovery and staged radio-profile provisioning over the
        native USB Serial/JTAG interface.

endmenu
```

## src/firmware/radio/transmitter/sdkconfig.defaults
```kconfig
CONFIG_ESP_CONSOLE_UART_BAUDRATE=921600
CONFIG_ESP_CONSOLE_UART_CUSTOM=y
CONFIG_ESP_CONSOLE_SECONDARY_USB_SERIAL_JTAG=n
CONFIG_ESP_WIFI_CSI_ENABLED=y
CONFIG_ESP_WIFI_DYNAMIC_TX_BUFFER_NUM=128
CONFIG_ESP_WIFI_AMPDU_TX_ENABLED=n
CONFIG_FREERTOS_HZ=1000
CONFIG_ESPTOOLPY_FLASHSIZE_4MB=y
CONFIG_PM_ENABLE=y
CONFIG_PM_DFS_INIT_AUTO=y
CONFIG_ESP_DEFAULT_CPU_FREQ_MHZ_80=y
CONFIG_CSI_USB_CONTROL=y
CONFIG_CSI_BLE_SCHEDULER=y
CONFIG_ESP_CONSOLE_SECONDARY_NONE=y
CONFIG_USJ_ENABLE_USB_SERIAL_JTAG=y
CONFIG_CSI_TX_POWER_QUARTER_DBM=44
CONFIG_CSI_CONTROL_TIMEOUT_MS=3000
```

## src/firmware/radio/transmitter/sdkconfig.defaults.esp32c5
```kconfig
CONFIG_IDF_TARGET="esp32c5"
CONFIG_ESP_CONSOLE_SECONDARY_USB_SERIAL_JTAG=y
CONFIG_ESP_WIFI_CSI_ENABLED=y
CONFIG_CSI_USB_CONTROL=y
```

## src/firmware/receiver/main/Kconfig.projbuild
```kconfig
menu "CSI receiver"

config CSI_CHANNEL
    int "Wi-Fi channel"
    range 1 11
    default 11
    help
        Fixed 2.4 GHz channel used for the ESP-NOW sensing packets.

config CSI_SEND_MAC
    string "Transmitter MAC address"
    default "1a:00:00:00:00:00"
    help
        MAC address of the transmitter whose packets should be logged.

endmenu
```

## src/firmware/transmitter/main/Kconfig.projbuild
```kconfig
menu "CSI transmitter"

config CSI_CHANNEL
    int "Wi-Fi channel"
    range 1 11
    default 11
    help
        Fixed 2.4 GHz channel used for the ESP-NOW sensing packets.

config CSI_PACKET_RATE
    int "Sensing packet rate (packets per second)"
    range 1 500
    default 100
    help
        Nominal rate of the sequence-numbered sensing packets. The upper
        bound keeps the period representable with the default 1 kHz RTOS tick.

config CSI_SEND_MAC
    string "Transmitter MAC address"
    default "1a:00:00:00:00:00"
    help
        Locally administered MAC used by the sensing transmitter. Enter six
        hexadecimal octets separated by colons.

endmenu
```

## src/firmware/transmitter/sdkconfig.defaults
```kconfig
CONFIG_ESP_CONSOLE_UART_BAUDRATE=921600
CONFIG_ESP_CONSOLE_UART_CUSTOM=y
CONFIG_ESP_WIFI_CSI_ENABLED=y
CONFIG_ESP_WIFI_DYNAMIC_TX_BUFFER_NUM=128
CONFIG_ESP_WIFI_AMPDU_TX_ENABLED=n
CONFIG_FREERTOS_HZ=1000
CONFIG_ESPTOOLPY_FLASHSIZE_4MB=y
```
